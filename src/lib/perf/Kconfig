## src/lib/perf/Kconfig
```kconfig
config PERF_COUNT_ONLY
	bool "Allocate only event (count) perf counters"
	default n
	depends on !SYSTEMCMDS_PERF
	help
	  perf_alloc() returns nullptr for elapsed and interval counters, which
	  are only read by the perf command. Saves heap on boards with little RAM
	  that do not build the perf command. Event counters are kept because
	  drivers read them for error reporting.
```

## src/modules/logger/Kconfig
```kconfig
menuconfig MODULES_LOGGER
	bool "logger"
	default n
	---help---
		Enable support for logger

menuconfig USER_LOGGER
	bool "logger running as userspace module"
	default y
	depends on BOARD_PROTECTED && MODULES_LOGGER
	---help---
		Put logger in userspace memory

menuconfig LOGGER_STACK_SIZE
	int "stack size of logger task"
	default 3700
	depends on MODULES_LOGGER
	---help---
		Stack size of the logger task. Some configurations require more stack
		than the default.

menuconfig LOGGER_WRITER_STACK_SIZE
	int "stack size of the log file writer thread"
	default 1170
	depends on MODULES_LOGGER
	---help---
		Stack size of the log_writer_file thread. File systems with deep call
		chains (e.g. littlefs on NAND) need more than the default.
```

## src/modules/mavlink/Kconfig
```kconfig
menuconfig MODULES_MAVLINK
	bool "mavlink"
	default n
	---help---
		Enable support for mavlink

menuconfig MAVLINK_DIALECT
depends on MODULES_MAVLINK
        string "Mavlink dialect"
        default "common"
	---help---
		Select the Mavlink dialect to generate and use.

menuconfig MAVLINK_UAVCAN_PARAMETERS
depends on MODULES_MAVLINK && DRIVERS_UAVCAN
        bool "Mavlink UAVCAN parameter support"
        default y
	---help---
		Expose UAVCAN parameters over Mavlink.

menuconfig MAVLINK_MAIN_STACK_SIZE
	int "stack size of each mavlink instance task"
	default 2896
	depends on MODULES_MAVLINK
	---help---
		Stack size of the mavlink_main task (one per instance), excluding the
		extra stack added for network links.

menuconfig MAVLINK_RECEIVER_EXTRA_STACK_SIZE
	int "extra stack size of the mavlink receive thread"
	default 2840
	depends on MODULES_MAVLINK
	---help---
		Stack added on top of sizeof(MavlinkReceiver) for the mavlink receive
		thread, excluding the extra stack added for network links.

menuconfig USER_MAVLINK
	bool "mavlink running as userspace module"
	default y
	depends on BOARD_PROTECTED && MODULES_MAVLINK
	---help---
		Put mavlink in userspace memory
```
